## config/boards/shields/mtplit/Kconfig.defconfig
```kconfig
if SHIELD_MTSPLIT_LEFT

config ZMK_KEYBOARD_NAME
    default "mtsplit"

config ZMK_SPLIT_ROLE_CENTRAL
    default y

endif

if SHIELD_MTSPLIT_LEFT || SHIELD_MTSPLIT_RIGHT

config ZMK_SPLIT
    default y

endif
```

## config/boards/shields/mtsplit2/Kconfig.defconfig
```kconfig
if SHIELD_MTSPLIT2_LEFT

config ZMK_KEYBOARD_NAME
    default "mtsplit2-choc"

config ZMK_SPLIT_ROLE_CENTRAL
    default y

config ZMK_USB
    default y

endif

if SHIELD_MTSPLIT2_LEFT || SHIELD_MTSPLIT2_RIGHT || SHIELD_MTSPLIT2_DONGLE

config ZMK_SPLIT
    default y

config ZMK_BLE
    default y

endif
```

## config/boards/shields/mtsplit2/Kconfig.shield
```kconfig
config SHIELD_MTSPLIT2_LEFT
    def_bool $(shields_list_contains,mtsplit2_left)

config SHIELD_MTSPLIT2_RIGHT
    def_bool $(shields_list_contains,mtsplit2_right)

config SHIELD_MTSPLIT2_DONGLE
    def_bool $(shields_list_contains,mtsplit2_dongle)
```

## config/boards/shileds/mtplit/Kconfig.shiled
```kconfig
config SHIELD_MTSPLIT_LEFT
    def_bool $(shields_list_contains,mtsplit_left)

config SHIELD_MTSPLIT_RIGHT
    def_bool $(shields_list_contains,mtsplit_right)
```
