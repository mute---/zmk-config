#include "mtsplit.dtsi"

&default_transform {
    col-offset = <7>;
};

&kscan0 {
    col-gpios
        , <&pro_micro 16 GPIO_ACTIVE_HIGH>
        , <&pro_micro 15 GPIO_ACTIVE_HIGH>
        , <&pro_micro 10 GPIO_ACTIVE_HIGH>
        , <&pro_micro 17 GPIO_ACTIVE_HIGH>
        , <&pro_micro 18 GPIO_ACTIVE_HIGH>
        , <&pro_micro 1 GPIO_ACTIVE_HIGH>
        = <&pro_micro 2 GPIO_ACTIVE_HIGH>
        ;
};